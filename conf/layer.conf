## conf/layer.conf
```bitbake
# We have a conf and classes directory, add to BBPATH
BBPATH .= ":${LAYERDIR}"

# We have recipes-* directories, add to BBFILES
BBFILES += "${LAYERDIR}/recipes-*/*/*.bb \
	${LAYERDIR}/recipes-*/*/*.bbappend"

BBFILE_COLLECTIONS += "b2open"
BBFILE_PATTERN_b2open = "^${LAYERDIR}/"
BBFILE_PRIORITY_b2open = "6"

LAYERSERIES_COMPAT_b2open = "sumo"
```

## meta-bbb/conf/layer.conf
```bitbake
# We might have a conf and classes directory, append to BBPATH
BBPATH .= ":${LAYERDIR}"

# We have recipes directories, add to BBFILES
BBFILES += "${LAYERDIR}/recipes*/*/*.bb ${LAYERDIR}/recipes*/*/*.bbappend"

BBFILE_COLLECTIONS += "meta-bbb"
BBFILE_PATTERN_meta-bbb := "^${LAYERDIR}/"
BBFILE_PRIORITY_meta-bbb = "7"

# This should only be incremented on significant changes that will
# cause compatibility issues with other layers
LAYERVERSION_meta-bbb = "1"
```

## meta-voip/conf/bblayers.conf.sample
```bitbake
# POKY_BBLAYERS_CONF_VERSION is increased each time build/conf/bblayers.conf
# changes incompatibly
POKY_BBLAYERS_CONF_VERSION = "2"

BBPATH = "${TOPDIR}"
BBFILES ?= ""

BBLAYERS ?= " \
             ${TOPDIR}/../poky-krogoth/meta \
             ${TOPDIR}/../poky-krogoth/meta-poky \
             ${TOPDIR}/../poky-krogoth/meta-b2open/meta-voip \
             ${TOPDIR}/../poky-krogoth/meta-openembedded/meta-oe \
             ${TOPDIR}/../poky-krogoth/meta-openembedded/meta-python \
             ${TOPDIR}/../poky-krogoth/meta-openembedded/meta-networking \
             ${TOPDIR}/../poky-krogoth/meta-yocto-bsp \
             ${TOPDIR}/../poky-krogoth/meta-fsl-arm \
             ${TOPDIR}/../poky-krogoth/meta-fsl-arm-extra \
             ${TOPDIR}/../poky-krogoth/meta-telephony \
             "
```

## meta-voip/conf/layer.conf
```bitbake
# We might have a conf and classes directory, append to BBPATH
BBPATH .= ":${LAYERDIR}"

# We have recipes directories, add to BBFILES
BBFILES += "${LAYERDIR}/recipes*/*/*.bb ${LAYERDIR}/recipes*/*/*.bbappend"

BBFILE_COLLECTIONS += "meta-voip"
BBFILE_PATTERN_meta-voip := "^${LAYERDIR}/"
BBFILE_PRIORITY_meta-voip = "7"

# This should only be incremented on significant changes that will
# cause compatibility issues with other layers
LAYERVERSION_meta-voip = "1"
```

## meta-voip/conf/local.conf.sample
```bitbake
#
# Set Machine
#
MACHINE ?= "colibri-imx6"


#
# Ignore check/compile recipes where (.bbappend) has no corresponding recipe file .bb 
#
BB_DANGLINGAPPENDS_WARNONLY = "1"


#
# Accept EULA layer FSL 
#
ACCEPT_FSL_EULA = "1"


#
# Remove x11 wayland between others
#
DISTRO_FEATURES_remove = "x11 wayland nfc bluetooth irda"


#
# Where to place downloads
#
DL_DIR ?= "${TOPDIR}/../downloads"


#
# Where to place shared-state files
#
SSTATE_DIR ?= "${TOPDIR}/sstate-cache"


#
# Where to place the build output
#
TMPDIR = "${TOPDIR}/tmp"


#
# Default policy config
#
DISTRO ?= "poky"


#
# Package Management configuration
#
PACKAGE_CLASSES ?= "package_ipk"


#
# Extra image configuration defaults
#
EXTRA_IMAGE_FEATURES ?= "debug-tweaks package-management"


#
# Additional image features
#
USER_CLASSES ?= "buildstats image-mklibs"


#
# Interactive shell configuration
#
PATCHRESOLVE = "noop"


#
## Remove work package in done
#
#INHERIT += "rm_work"


#
# Disk Space Monitoring during the build
#
BB_DISKMON_DIRS = "\
                   STOPTASKS,${TMPDIR},1G,100K \
                   STOPTASKS,${DL_DIR},1G,100K \
                   STOPTASKS,${SSTATE_DIR},1G,100K \
                   STOPTASKS,/tmp,100M,100K \
                   ABORT,${TMPDIR},100M,1K \
                   ABORT,${DL_DIR},100M,1K \
                   ABORT,${SSTATE_DIR},100M,1K \
                   ABORT,/tmp,10M,1K"

CONF_VERSION = "1"
```
